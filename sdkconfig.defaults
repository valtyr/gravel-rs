## sdkconfig.defaults
```kconfig
# Rust often needs a bit of an extra main task stack size compared to C (the default is 3K)
CONFIG_ESP_MAIN_TASK_STACK_SIZE=16000

# Use this to set FreeRTOS kernel tick frequency to 1000 Hz (100 Hz by default).
# This allows to use 1 ms granularity for thread sleeps (10 ms by default).
CONFIG_FREERTOS_HZ=1000

# ESP32-C6 Configuration
CONFIG_IDF_TARGET_ESP32C6=y

# Enable BLE for ESP32-C6 with NimBLE stack
CONFIG_BT_ENABLED=y

# Disable Bluedroid (using NimBLE only for our custom implementation)
CONFIG_BT_BLUEDROID_ENABLED=n
CONFIG_ESP_IDF_BT_ENABLED=y
CONFIG_ESP_IDF_BT_BLUEDROID_ENABLED=n

# Enable NimBLE for our custom BLE implementation
CONFIG_BT_NIMBLE_ENABLED=y
CONFIG_BT_NIMBLE_MAX_CONNECTIONS=1
CONFIG_BT_NIMBLE_MAX_BONDS=3
CONFIG_BT_NIMBLE_PINNED_TO_CORE=0

# ESP32-C6 specific BLE controller settings
CONFIG_BT_CONTROLLER_ENABLED=y
CONFIG_BT_CTRL_BLE_MAX_CONN=1
CONFIG_BT_CTRL_BLE_MAX_CONN_EFF=1

# NimBLE specific optimizations
CONFIG_BT_NIMBLE_MEM_ALLOC_MODE_EXTERNAL=y
CONFIG_BT_NIMBLE_TASK_STACK_SIZE=4096

# Wi-Fi Configuration
CONFIG_ESP32_WIFI_ENABLED=y
CONFIG_ESP32_WIFI_SW_COEXIST_ENABLE=y

# WiFi Performance Optimizations
CONFIG_ESP32_WIFI_STATIC_RX_BUFFER_NUM=8
CONFIG_ESP32_WIFI_DYNAMIC_RX_BUFFER_NUM=16
CONFIG_ESP32_WIFI_STATIC_TX_BUFFER_NUM=4
CONFIG_ESP32_WIFI_DYNAMIC_TX_BUFFER_NUM=16
CONFIG_ESP32_WIFI_CSI_ENABLED=n
CONFIG_ESP32_WIFI_AMPDU_TX_ENABLED=y
CONFIG_ESP32_WIFI_AMPDU_RX_ENABLED=y

# WiFi Connection Optimizations
CONFIG_ESP32_WIFI_NVS_ENABLED=y
CONFIG_ESP32_WIFI_TASK_PINNED_TO_CORE_0=y
CONFIG_ESP32_WIFI_SOFTAP_BEACON_MAX_LEN=752
CONFIG_ESP32_WIFI_MGMT_SBUF_NUM=32

# WiFi Scan and Connection Timeouts - Aggressive settings for fast startup
CONFIG_ESP32_WIFI_SCAN_CACHE_SIZE=4
CONFIG_ESP32_WIFI_CONNECT_TIMEOUT=5
CONFIG_ESP32_WIFI_BEACON_TIMEOUT=3
CONFIG_ESP32_WIFI_MAX_CONN_FAIL_RETRY=0
CONFIG_ESP32_WIFI_SCAN_MAX_AP=8
CONFIG_ESP32_WIFI_SCAN_RSSI_THRESHOLD=-80

# Low-level WiFi timing optimizations
CONFIG_ESP32_WIFI_AUTH_TIMEOUT=5000
CONFIG_ESP32_WIFI_ASSOC_TIMEOUT=5000
CONFIG_ESP32_WIFI_HANDSHAKE_TIMEOUT=5000

# WiFi Provisioning Configuration
CONFIG_WIFI_PROV_ENABLE=y
CONFIG_WIFI_PROV_STA_ALL_CHANNEL_SCAN=y
CONFIG_WIFI_PROV_BLE_ENABLE=y
CONFIG_WIFI_PROV_AUTOSTOP_TIMEOUT=15

# Memory Configuration
CONFIG_SPIRAM_SUPPORT=y
CONFIG_SPIRAM_USE_MALLOC=y

# HTTP Server and WebSocket Configuration  
CONFIG_LWIP_MAX_SOCKETS=32
CONFIG_HTTPD_WS_SUPPORT=y
CONFIG_HTTPD_MAX_REQ_HDR_LEN=1024
CONFIG_HTTPD_MAX_URI_LEN=512

# HTTP Server Session Configuration
CONFIG_HTTPD_MAX_SESSIONS=16
CONFIG_HTTPD_WS_MAX_FRAME_SIZE=1024

# LWIP Network Stack Optimizations
CONFIG_LWIP_TCP_SND_BUF_DEFAULT=5760
CONFIG_LWIP_TCP_WND_DEFAULT=5760
CONFIG_LWIP_TCP_RECVMBOX_SIZE=6
CONFIG_LWIP_UDP_RECVMBOX_SIZE=6
CONFIG_LWIP_TCPIP_RECVMBOX_SIZE=32
CONFIG_LWIP_DHCP_DOES_ARP_CHECK=n
CONFIG_LWIP_DHCP_RESTORE_LAST_IP=y

# Security Configuration
CONFIG_MBEDTLS_CERTIFICATE_BUNDLE=y
CONFIG_MBEDTLS_CERTIFICATE_BUNDLE_DEFAULT_FULL=y

# Logging Configuration
CONFIG_LOG_DEFAULT_LEVEL_INFO=y

CONFIG_BOOTLOADER_APP_OTA=n
CONFIG_OTA_SUPPORT=n


CONFIG_ESP_TASK_WDT_PANIC=n
CONFIG_ESP32C6_USB_CDC_SUPPORTED=y
CONFIG_ESP32C6_REV_MIN_0=y
```
